## boards/shields/tinytb/Kconfig.defconfig
```kconfig
if SHIELD_TINYTRAK

    config ZMK_KEYBOARD_NAME
        default "TinyTrak"

    config INPUT
        bool
        default y

    config PMW3610
        bool
        default y

    config SPI
        bool
        default y

    config ZMK_BLE
        bool
        default y

    config ZMK_POINTING
        bool
        default y

config RGBLED_WIDGET_BATTERY_LEVEL_HIGH
    default 30

config RGBLED_WIDGET_BATTERY_LEVEL_CRITICAL
    default 10


endif
```

## config/west.yml
```yaml
manifest:
  remotes:
    - name: zmkfirmware
      url-base: https://github.com/zmkfirmware
    - name: k3peta
      url-base: https://github.com/k3peta
    - name: badjeff
      url-base: https://github.com/badjeff
    - name: caksoylar
      url-base: https://github.com/caksoylar
    - name: kot149
      url-base: https://github.com/kot149

  projects:
    - name: zmk
      remote: zmkfirmware
      revision: v0.3.0
      import: app/west.yml

    - name: zmk-pmw3610-driver
      remote: badjeff
      revision: main

    - name: zmk-rgbled-widget
      remote: caksoylar
      revision: main

    - name: zmk-scroll-snap
      remote: kot149
      revision: v1

  self:
    path: config
```
