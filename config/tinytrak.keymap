#include <behaviors.dtsi>
#include <dt-bindings/zmk/keys.h>
#include <dt-bindings/zmk/mouse.h>

 / {
    keymap {
        compatible = "zmk,keymap";

        // Layer 0: 通常
        default_layer {
            bindings = <
                &lt 1 &mkp RCLK      &mmv MOVE_LEFT
                &mkp LCLK           &mmv MOVE_RIGHT
            >;
        };

        // Layer 1: スクロール専用（ホールド中のみ有効）
        scroll_layer {
            bindings = <
                &trans              &msc SCRL_LEFT
                &trans              &msc SCRL_RIGHT
            >;
        };
    };
 };
